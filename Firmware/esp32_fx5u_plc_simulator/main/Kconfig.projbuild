## Firmware/esp32_fx5u_plc_simulator/main/Kconfig.projbuild
```kconfig
menu "AquaOps FX5U simulator"
    config PLC_WIFI_SSID
        string "Wi-Fi SSID"
        default "CHANGE_ME"
    config PLC_WIFI_PASSWORD
        string "Wi-Fi password"
        default "CHANGE_ME"
    config PLC_MODBUS_PORT
        int "Modbus TCP port"
        range 1 65535
        default 1502
    config PLC_UNIT_ID
        int "Modbus Unit ID"
        range 1 247
        default 1
    config PLC_WATCHDOG_SECONDS
        int "Communication watchdog (seconds)"
        range 5 300
        default 15
endmenu
```

## Firmware/esp32_sensor_node/main/Kconfig.projbuild
```kconfig
menu "AquaOps sensor node"
    config AQUA_FLASH_BUFFER_CAPACITY
        int "Durable offline record capacity"
        range 32 512
        default 128
        help
            Telemetry records retained in NVS until AquaOps returns an application-level ACK.
endmenu
```

## Firmware/esp32_sensor_node/sdkconfig.defaults
```kconfig
CONFIG_ESP_MAIN_TASK_STACK_SIZE=8192
CONFIG_ESPTOOLPY_FLASHSIZE_4MB=y
CONFIG_MQTT_PROTOCOL_311=y
CONFIG_LWIP_SNTP_MAX_SERVERS=1
CONFIG_PARTITION_TABLE_CUSTOM=y
CONFIG_PARTITION_TABLE_CUSTOM_FILENAME="partitions.csv"
```
